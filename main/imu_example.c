// SPDX-License-Identifier: MIT
//
// Two BMI270s and a BMM150.
//
// The M135 puts a BMI270 at 0x69. The Tab5 already has one at 0x68. They sit
// on the same wire, so this file drives both and prints them side by side —
// that redundancy is most of the point of stacking the module.
//
// The BMM150 is not on this bus at all. It hangs off the BMI270's auxiliary
// I2C master, so it is reached by asking the 0x69 BMI270 to talk to it.

#include <math.h>
#include <string.h>
#include "freertos/FreeRTOS.h"
#include "freertos/task.h"
#include "esp_timer.h"
#include "esp_log.h"
#include "tab5_bus.h"
#include "imu_example.h"

// Generated by tools/fetch_bmi270_config.sh from Bosch's BMI270-Sensor-API.
// See the README: without it the sensors answer their chip ID and nothing else.
#if __has_include("bmi270_config_file.h")
#include "bmi270_config_file.h"
#define HAVE_BMI270_CONFIG 1
#endif

// Bosch's reference drivers, vendored by tools/fetch_bosch_drivers.sh. Only
// the magnetometer needs them; accelerometer and gyroscope work without.
#if __has_include("bmi270.h")
#include "bosch_aux.h"
#define HAVE_BOSCH_DRIVERS 1
#endif

static const char *TAG = "tab5_imu";

// --- BMI270 registers ---------------------------------------------------
#define BMI270_REG_CHIP_ID        0x00
#define BMI270_REG_ERR            0x02
#define BMI270_REG_STATUS         0x03
#define BMI270_REG_ACC_DATA       0x0C
#define BMI270_REG_GYR_DATA       0x12
#define BMI270_REG_INTERNAL_STAT  0x21
#define BMI270_REG_ACC_CONF       0x40
#define BMI270_REG_ACC_RANGE      0x41
#define BMI270_REG_GYR_CONF       0x42
#define BMI270_REG_GYR_RANGE      0x43
#define BMI270_REG_INIT_CTRL      0x59
#define BMI270_REG_INIT_ADDR_0    0x5B
#define BMI270_REG_INIT_ADDR_1    0x5C
#define BMI270_REG_INIT_DATA      0x5E
#define BMI270_REG_PWR_CONF       0x7C
#define BMI270_REG_PWR_CTRL       0x7D
#define BMI270_REG_CMD            0x7E

#define BMI270_CHIP_ID            0x24


typedef struct {
    const char *label;
    uint8_t addr;
    i2c_master_dev_handle_t dev;
    bool configured;
    float acc_lsb_per_g;
    float gyr_lsb_per_dps;
} bmi270_t;

static bmi270_t s_module = { .label = "M135",  .addr = M135_BMI270_ADDR };
static bmi270_t s_onboard = { .label = "Tab5", .addr = 0x68 };
static bool s_mag_ok;

// --- init ---------------------------------------------------------------

#ifdef HAVE_BMI270_CONFIG
// The config blob goes out in chunks. Each chunk is addressed by a word
// offset split across INIT_ADDR_0 (low nibble) and INIT_ADDR_1, so the chunk
// size has to be even and the offset is bytes/2 — getting that shift wrong
// uploads a valid-looking image that fails INTERNAL_STATUS with no clue why.
#define INIT_CHUNK 64

static esp_err_t bmi270_upload_config(bmi270_t *s)
{
    uint8_t buf[1 + INIT_CHUNK];

    ESP_ERROR_CHECK(tab5_reg_write8(s->dev, BMI270_REG_PWR_CONF, 0x00));  // no adv power save
    vTaskDelay(pdMS_TO_TICKS(1));
    ESP_ERROR_CHECK(tab5_reg_write8(s->dev, BMI270_REG_INIT_CTRL, 0x00)); // begin upload

    for (size_t off = 0; off < sizeof(bmi270_config_file); off += INIT_CHUNK) {
        size_t n = sizeof(bmi270_config_file) - off;
        if (n > INIT_CHUNK) n = INIT_CHUNK;

        size_t words = off / 2;
        ESP_ERROR_CHECK(tab5_reg_write8(s->dev, BMI270_REG_INIT_ADDR_0, words & 0x0F));
        ESP_ERROR_CHECK(tab5_reg_write8(s->dev, BMI270_REG_INIT_ADDR_1, (words >> 4) & 0xFF));

        buf[0] = BMI270_REG_INIT_DATA;
        memcpy(buf + 1, bmi270_config_file + off, n);
        esp_err_t err = i2c_master_transmit(s->dev, buf, n + 1, pdMS_TO_TICKS(200));
        if (err != ESP_OK) return err;
    }

    ESP_ERROR_CHECK(tab5_reg_write8(s->dev, BMI270_REG_INIT_CTRL, 0x01)); // end upload

    // The datasheet allows up to 20 ms for the internal init to settle.
    for (int i = 0; i < 40; i++) {
        vTaskDelay(pdMS_TO_TICKS(5));
        uint8_t st = 0;
        if (tab5_reg_read(s->dev, BMI270_REG_INTERNAL_STAT, &st, 1) != ESP_OK) continue;
        if ((st & 0x0F) == 0x01) {
            ESP_LOGI(TAG, "%s: config uploaded, internal status ok", s->label);
            return ESP_OK;
        }
    }
    ESP_LOGE(TAG, "%s: config upload did not take (INTERNAL_STATUS never reached 0x01)", s->label);
    return ESP_ERR_INVALID_STATE;
}
#endif

// Derives the LSB-per-unit factors from the range registers rather than from
// what this file thinks it set. Necessary because Bosch's driver reconfigures
// the M135's BMI270 during magnetometer bring-up: a stale factor silently
// halves every acceleration reading, which looks like a mounting problem
// rather than a units bug.
static void bmi270_refresh_scale(bmi270_t *s)
{
    uint8_t acc_range = 0x01, gyr_range = 0x00;
    tab5_reg_read(s->dev, BMI270_REG_ACC_RANGE, &acc_range, 1);
    tab5_reg_read(s->dev, BMI270_REG_GYR_RANGE, &gyr_range, 1);

    acc_range &= 0x03;   // 0 = +/-2 g, then 4, 8, 16
    gyr_range &= 0x07;   // 0 = +/-2000 dps, halving each step down to 125

    s->acc_lsb_per_g   = 32768.0f / (float)(2 << acc_range);
    s->gyr_lsb_per_dps = 32768.0f / (float)(2000 >> gyr_range);

    ESP_LOGI(TAG, "%s: scale +/-%d g, +/-%d dps", s->label,
             2 << acc_range, 2000 >> gyr_range);
}

static esp_err_t bmi270_open(bmi270_t *s)
{
    esp_err_t err = tab5_bus_add_device(s->addr, &s->dev);
    if (err != ESP_OK) return err;

    // A power-cycled BMI270 comes up in SPI mode and needs one dummy read to
    // latch onto I2C. The first read returning garbage is expected, not a fault.
    uint8_t id = 0;
    tab5_reg_read(s->dev, BMI270_REG_CHIP_ID, &id, 1);
    vTaskDelay(pdMS_TO_TICKS(2));

    err = tab5_reg_read(s->dev, BMI270_REG_CHIP_ID, &id, 1);
    if (err != ESP_OK) {
        ESP_LOGE(TAG, "%s: nothing at 0x%02X (%s)", s->label, s->addr, esp_err_to_name(err));
        return err;
    }
    if (id != BMI270_CHIP_ID) {
        ESP_LOGE(TAG, "%s: chip ID 0x%02X at 0x%02X, expected 0x24", s->label, id, s->addr);
        return ESP_ERR_NOT_FOUND;
    }
    ESP_LOGI(TAG, "%s: BMI270 at 0x%02X", s->label, s->addr);

#ifdef HAVE_BMI270_CONFIG
    err = bmi270_upload_config(s);
    if (err != ESP_OK) return err;

    ESP_ERROR_CHECK(tab5_reg_write8(s->dev, BMI270_REG_PWR_CTRL, 0x0E));  // acc + gyr + temp
    ESP_ERROR_CHECK(tab5_reg_write8(s->dev, BMI270_REG_ACC_CONF, 0xA8));  // 100 Hz, normal filter
    ESP_ERROR_CHECK(tab5_reg_write8(s->dev, BMI270_REG_ACC_RANGE, 0x01)); // +/- 4 g
    ESP_ERROR_CHECK(tab5_reg_write8(s->dev, BMI270_REG_GYR_CONF, 0xA9));  // 200 Hz, perf mode
    ESP_ERROR_CHECK(tab5_reg_write8(s->dev, BMI270_REG_GYR_RANGE, 0x00)); // +/- 2000 dps
    ESP_ERROR_CHECK(tab5_reg_write8(s->dev, BMI270_REG_PWR_CONF, 0x02));  // fifo self-wake

    bmi270_refresh_scale(s);
    s->configured = true;
    vTaskDelay(pdMS_TO_TICKS(20));
#else
    ESP_LOGW(TAG, "%s: no config file, sensor stays in suspend (see README)", s->label);
#endif
    return ESP_OK;
}

// --- BMM150, via Bosch's driver -----------------------------------------
//
// The BMI270's auxiliary I2C master is not a bus that can be driven by writing
// the obvious registers in the obvious order. Its write primitive loads
// AUX_WR_DATA before AUX_WR_ADDR, because writing the address is what triggers
// the transaction; it polls an aux_busy bit between operations; and it drops
// advanced power save around each transfer. A hand-rolled sequence here failed
// with aux_err on every transaction across several rounds of debugging, and
// none of the failures pointed at the cause. M5's own library wraps this same
// Bosch API rather than doing it by hand. See tools/fetch_bosch_drivers.sh.

static esp_err_t bmm150_start(bmi270_t *s)
{
#ifdef HAVE_BOSCH_DRIVERS
    if (bosch_aux_bmm150_start(s->addr) != ESP_OK) {
        ESP_LOGW(TAG, "BMM150 bring-up failed through the Bosch driver");
        return ESP_ERR_NOT_FOUND;
    }
    // Bosch's init reconfigures this chip's ranges, so re-read them before
    // the next sample is scaled.
    bmi270_refresh_scale(s);
    ESP_LOGI(TAG, "BMM150 at aux 0x%02X behind the M135 BMI270",
             M135_BMM150_AUX_ADDR);
    return ESP_OK;
#else
    ESP_LOGW(TAG, "magnetometer needs Bosch's drivers: run");
    ESP_LOGW(TAG, "  ./tools/fetch_bosch_drivers.sh");
    ESP_LOGW(TAG, "then rebuild. Accelerometer and gyroscope are unaffected.");
    return ESP_ERR_NOT_SUPPORTED;
#endif
}

// --- magnetometer calibration -------------------------------------------
//
// The BMM150 sits a few centimetres from the Tab5's speaker, whose permanent
// magnet adds a fixed vector in sensor frame. That offset is comparable in
// size to Earth's field, so uncorrected readings swing between roughly a
// quarter and double the true magnitude as the board turns, and a heading
// derived from them is meaningless.
//
// The correction is the classic hard-iron one: tumble the assembly through
// every orientation, take the midpoint of each axis's observed range, and
// subtract. Set MAG_OFFSET below once you have measured your own, or leave it
// zeroed and use the live calibration to find them.
//
// Only valid while the module stays in the same physical relationship to the
// Tab5. Reseat it, or move it to another Tab5, and it must be redone. The
// field from the voice coil during playback is not correctable by any of
// this, since it varies with the audio.

// Set to 1 to run the tumble calibration at boot instead of applying
// MAG_OFFSET. Rotate the whole assembly slowly through as many orientations
// as you can while it runs; a full turn about each of the three axes is the
// goal, and each axis has to reach both its extremes or the midpoint comes
// out biased. The result is printed ready to paste into MAG_OFFSET below.
// 0 = apply MAG_OFFSET and report corrected field (normal operation)
// 1 = measure offsets by tumbling, then print them for pasting below
// 2 = apply MAG_OFFSET and check it, by tracking how much |B| varies with
//     orientation. A good correction leaves |B| constant.
#define MAG_CALIBRATE      0
#define MAG_CAL_SECONDS    60

#if MAG_CALIBRATE != 1
// Measured on one Tab5 + M135 pairing by the tumble calibration below. Yours
// will differ. Declared only when not calibrating, since IDF builds with
// -Werror and an unused constant is an error rather than a warning.
static const float MAG_OFFSET[3] = { 29.5f, 41.5f, 21.0f };
#endif

#if MAG_CALIBRATE == 1
static float s_cal_min[3] = { +1e9f, +1e9f, +1e9f };
static float s_cal_max[3] = { -1e9f, -1e9f, -1e9f };
static int64_t s_cal_start_us;
static bool s_cal_done;

static void mag_calibrate(float v[3])
{
    if (s_cal_done) return;

    if (!s_cal_start_us) {
        s_cal_start_us = esp_timer_get_time();
        ESP_LOGW(TAG, "magnetometer calibration: tumble the Tab5 slowly for %d s",
                 MAG_CAL_SECONDS);
    }

    for (int i = 0; i < 3; i++) {
        if (v[i] < s_cal_min[i]) s_cal_min[i] = v[i];
        if (v[i] > s_cal_max[i]) s_cal_max[i] = v[i];
    }

    int64_t elapsed = (esp_timer_get_time() - s_cal_start_us) / 1000000;
    if (elapsed < MAG_CAL_SECONDS) return;

    s_cal_done = true;

    float off[3], rad[3], mean = 0.0f;
    for (int i = 0; i < 3; i++) {
        off[i] = (s_cal_max[i] + s_cal_min[i]) / 2.0f;
        rad[i] = (s_cal_max[i] - s_cal_min[i]) / 2.0f;
        mean += rad[i] / 3.0f;
    }

    ESP_LOGW(TAG, "calibration complete:");
    for (int i = 0; i < 3; i++) {
        ESP_LOGW(TAG, "  %c: min %+7.1f  max %+7.1f  offset %+7.1f  radius %6.1f uT",
                 'X' + i, s_cal_min[i], s_cal_max[i], off[i], rad[i]);
    }
    ESP_LOGW(TAG, "  static const float MAG_OFFSET[3] = { %.1ff, %.1ff, %.1ff };",
             off[0], off[1], off[2]);
    ESP_LOGW(TAG, "mean radius %.1f uT — should be close to your local field", mean);

    // All three radii measure the same field magnitude, so on a well-sampled
    // sphere they should come out equal. They often do not, and min/max
    // calibration cannot tell you why: an axis that never reached its extremes
    // shrinks its own radius, and so does genuine soft-iron distortion from
    // nearby steel. Both look identical here.
    //
    // Note also that an axis reading min = 0 is not evidence of anything by
    // itself. If the hard-iron offset exceeds the field radius, that axis never
    // goes negative however thoroughly you tumble — and when min is exactly 0
    // the arithmetic forces offset == radius, so their agreement is a
    // tautology rather than a finding.
    //
    // Set MAG_CALIBRATE to 2 to find out which it is.
    float spread = 0.0f;
    for (int i = 0; i < 3; i++) {
        float d = fabsf(rad[i] - mean) / mean;
        if (d > spread) spread = d;
    }
    if (spread > 0.15f) {
        ESP_LOGW(TAG, "radii differ by %.0f%%: either an axis missed its", spread * 100.0f);
        ESP_LOGW(TAG, "extremes, or soft-iron distortion. Verify with MAG_CALIBRATE 2");
    }
}
#endif

#if MAG_CALIBRATE == 2
// Checks a correction rather than producing one. Earth's field has a fixed
// magnitude, so once the hard-iron offset is removed |B| should be the same
// whichever way the board points. Residual variation is what is left
// uncorrected — soft-iron distortion, or an offset that is still wrong.
static float s_ver_min = +1e9f, s_ver_max = -1e9f, s_ver_sum;
static int   s_ver_n;
static int64_t s_ver_start_us;
static bool s_ver_done;

static void mag_verify(float b)
{
    if (s_ver_done) return;

    if (!s_ver_start_us) {
        s_ver_start_us = esp_timer_get_time();
        ESP_LOGW(TAG, "checking calibration: tumble again for %d s", MAG_CAL_SECONDS);
    }

    if (b < s_ver_min) s_ver_min = b;
    if (b > s_ver_max) s_ver_max = b;
    s_ver_sum += b;
    s_ver_n++;

    if ((esp_timer_get_time() - s_ver_start_us) / 1000000 < MAG_CAL_SECONDS) return;
    s_ver_done = true;

    float avg = s_ver_sum / (float)s_ver_n;
    float spread = (s_ver_max - s_ver_min) / avg;

    ESP_LOGW(TAG, "calibration check over %d samples:", s_ver_n);
    ESP_LOGW(TAG, "  |B| min %.1f  max %.1f  mean %.1f uT  spread %.0f%%",
             s_ver_min, s_ver_max, avg, spread * 100.0f);

    if (spread < 0.15f) {
        ESP_LOGW(TAG, "  flat: the offsets are good. Compare the mean against your");
        ESP_LOGW(TAG, "  local field (~50 uT mid-latitude) to check the scale.");
    } else {
        ESP_LOGW(TAG, "  still varying with orientation, so something is uncorrected.");
        ESP_LOGW(TAG, "  Re-run MAG_CALIBRATE 1 with a slower, fuller tumble first;");
        ESP_LOGW(TAG, "  if the spread persists it is soft-iron and needs per-axis");
        ESP_LOGW(TAG, "  scaling, which this example does not do.");
    }
}
#endif

// --- reporting ----------------------------------------------------------

static void read_and_log(bmi270_t *s)
{
    if (!s->configured) return;

    uint8_t raw[12];
    if (tab5_reg_read(s->dev, BMI270_REG_ACC_DATA, raw, sizeof(raw)) != ESP_OK) {
        ESP_LOGW(TAG, "%s: read failed", s->label);
        return;
    }
    int16_t ax = (int16_t)(raw[1]  << 8 | raw[0]);
    int16_t ay = (int16_t)(raw[3]  << 8 | raw[2]);
    int16_t az = (int16_t)(raw[5]  << 8 | raw[4]);
    int16_t gx = (int16_t)(raw[7]  << 8 | raw[6]);
    int16_t gy = (int16_t)(raw[9]  << 8 | raw[8]);
    int16_t gz = (int16_t)(raw[11] << 8 | raw[10]);

    ESP_LOGI(TAG, "  %-5s acc %+7.3f %+7.3f %+7.3f g   gyr %+8.2f %+8.2f %+8.2f dps",
             s->label,
             ax / s->acc_lsb_per_g, ay / s->acc_lsb_per_g, az / s->acc_lsb_per_g,
             gx / s->gyr_lsb_per_dps, gy / s->gyr_lsb_per_dps, gz / s->gyr_lsb_per_dps);
}

static void imu_task(void *arg)
{
    for (;;) {
        ESP_LOGI(TAG, "---");
        read_and_log(&s_onboard);
        read_and_log(&s_module);

#ifdef HAVE_BOSCH_DRIVERS
        if (s_mag_ok) {
            float mx, my, mz;
            if (bosch_aux_bmm150_read_ut(&mx, &my, &mz) == ESP_OK) {
#if MAG_CALIBRATE == 1
                float raw[3] = { mx, my, mz };
                mag_calibrate(raw);
#else
                mx -= MAG_OFFSET[0];
                my -= MAG_OFFSET[1];
                mz -= MAG_OFFSET[2];
#endif
                // Microtesla: compensated against the BMM150's factory trim
                // by Bosch's driver, then hard-iron corrected by MAG_OFFSET.
                // With a good calibration |B| should hold near your local
                // field (25-65 uT by latitude) through every orientation.
                // If it still swings, the offsets are wrong or stale.
                float b = sqrtf(mx * mx + my * my + mz * mz);
                ESP_LOGI(TAG, "  mag   %+8.2f %+8.2f %+8.2f uT  (|B| %.1f)", mx, my, mz, b);
#if MAG_CALIBRATE == 2
                mag_verify(b);
#endif
            }
        }
#endif
        vTaskDelay(pdMS_TO_TICKS(1000));
    }
}

esp_err_t imu_example_start(void)
{
#ifndef HAVE_BMI270_CONFIG
    ESP_LOGW(TAG, "built without bmi270_config_file.h");
    ESP_LOGW(TAG, "run ./tools/fetch_bmi270_config.sh, then rebuild");
#endif

    // The Tab5's own IMU is optional here; a failure there should not stop the
    // module from coming up.
    if (bmi270_open(&s_onboard) != ESP_OK) {
        ESP_LOGW(TAG, "Tab5 onboard BMI270 unavailable, continuing with the module only");
    }

    esp_err_t err = bmi270_open(&s_module);
    if (err != ESP_OK) {
        ESP_LOGE(TAG, "M135 BMI270 not found. Is the module seated and EXT5V on?");
        return err;
    }

    if (s_module.configured) {
        s_mag_ok = (bmm150_start(&s_module) == ESP_OK);
    }

    xTaskCreate(imu_task, "imu", 4096, NULL, 4, NULL);
    return ESP_OK;
}
